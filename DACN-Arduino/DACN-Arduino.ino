#include <LEDMatrixDriver.hpp>
#include <ESP8266WiFi.h>
#include <WiFiClient.h>
#include <string.h>

// ================= CẤU HÌNH WIFI =================
const char* ssid = "123";
const char* password = "vandepgai";

WiFiServer server(80);

const uint8_t LEDMATRIX_CS_PIN = 15;

// ================= CẤU HÌNH LED MAX7219 =================
const int LEDMATRIX_SEGMENTS = 4;
const int LEDMATRIX_WIDTH = 32;
const int LEDMATRIX_HEIGHT = 8;

LEDMatrixDriver lmd(LEDMATRIX_SEGMENTS, LEDMATRIX_CS_PIN);

// ================= FONT 8x8 =================
byte font[][8] = {
  {0,0,0,0,0,0,0,0}, // space
  {0x18,0x3C,0x3C,0x18,0x18,0x00,0x18,0x00}, // !
  {0x36,0x36,0x00,0x00,0x00,0x00,0x00,0x00}, // "
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  {0x6E,0x3B,0x00,0x00,0x00,0x00,0x00,0x00}  // ~
};

// ================= BIẾN TOÀN CỤC =================
int x = LEDMATRIX_WIDTH;
int brightness = 2;

char text[75] = " San Sang ";
int len = strlen(text);

const int ANIM_DELAY = 75;
int animationSpeed = ANIM_DELAY;
unsigned long myTime = 0;

IPAddress ip;

enum DisplayState { STOPPED, RUNNING };
DisplayState currentState = RUNNING;

int numLoops = 1;
int currentLoop = 0;
bool displayOn = true;

bool enableBlink = false;
bool showText = true;
unsigned long lastBlinkTime = 0;
const int BLINK_INTERVAL = 500;

// Thêm biến effect
int textEffect = 0;      // 0 = chạy ngang cũ, 1 = hiện từng chữ dạng 4 ô
int typeIndex = 0;
unsigned long effectTime = 0;
const int TYPE_DELAY = 400;

// ================= HÀM HỖ TRỢ =================
String urlDecode(String input) {
  String decoded = "";
  char temp[] = "0x00";

  for (unsigned int i = 0; i < input.length(); i++) {
    char c = input.charAt(i);

    if (c == '+') {
      decoded += ' ';
    } else if (c == '%' && i + 2 < input.length()) {
      temp[2] = input.charAt(i + 1);
      temp[3] = input.charAt(i + 2);
      decoded += (char)strtol(temp, NULL, 16);
      i += 2;
    } else {
      decoded += c;
    }
  }

  return decoded;
}

String getParam(String params, String key) {
  String searchKey = key + "=";
  int start = params.indexOf(searchKey);
  if (start < 0) return "";

  start += searchKey.length();

  int end = params.indexOf('&', start);
  if (end < 0) end = params.indexOf(' ', start);
  if (end < 0) end = params.length();

  return params.substring(start, end);
}

void safeCopyText(const String& src) {
  String clean = src;
  clean.replace("\r", "");
  clean.replace("\n", "");

  strncpy(text, clean.c_str(), sizeof(text) - 1);
  text[sizeof(text) - 1] = '\0';
  len = strlen(text);
}

void drawSprite(byte* sprite, int x, int y, int width, int height) {
  for (int iy = 0; iy < height; iy++) {
    byte mask = B10000000;

    for (int ix = 0; ix < width; ix++) {
      bool pixel = sprite[iy] & mask;

      int px = x + (width - 1 - ix);
      int py = y + iy;

      if (px >= 0 && px < LEDMATRIX_WIDTH && py >= 0 && py < LEDMATRIX_HEIGHT) {
        lmd.setPixel(px, py, pixel);
      }

      mask >>= 1;
    }
  }
}

void drawString(char* textPtr, int lenText, int xPos, int yPos) {
  for (int idx = 0; idx < lenText; idx++) {
    char ch = textPtr[idx];

    if (ch < 32 || ch > 126) continue;

    int c = ch - 32;

    if (c < 0 || c >= 95) continue;

    int charX = xPos + idx * 8;

    if (charX >= LEDMATRIX_WIDTH) continue;
    if (charX + 7 < 0) continue;

    drawSprite(font[c], charX, yPos, 8, 8);
  }
}

// void displayText(char* theText) 
// {
//   if (currentState != RUNNING) {
//     lmd.display();
//     return;
//   }

//   if (myTime + animationSpeed < millis()) {
//     myTime = millis();

//     lmd.clear();

//     if (showText) {
//       drawString(theText, len, x, 0);
//     }

//     lmd.display();
//     x--;

//     if (x < len * -8) {
//       currentLoop++;

//       if (currentLoop < numLoops) {
//         x = LEDMATRIX_WIDTH;
//       } else {
//         x = LEDMATRIX_WIDTH;
//         currentLoop = 0;
//         currentState = STOPPED;
//         lmd.clear();
//         lmd.display();
//       }
//     }
//   }
// }

void displayText(char* theText) {
  if (currentState != RUNNING) {
    lmd.display();
    return;
  }

  // EFFECT 0: chạy chữ ngang như cũ
  if (textEffect == 0) {
    if (millis() - myTime < animationSpeed) return;
    myTime = millis();

    lmd.clear();

    if (showText) {
      drawString(theText, len, x, 0);
    }

    lmd.display();
    x--;

    if (x < len * -8) {
      currentLoop++;

      if (currentLoop < numLoops) {
        x = LEDMATRIX_WIDTH;
      } else {
        x = LEDMATRIX_WIDTH;
        currentLoop = 0;
        currentState = STOPPED;
        lmd.clear();
        lmd.display();
      }
    }

    return;
  }

  // EFFECT 1: hiện từng chữ dạng cửa sổ 4 ký tự
  // Ví dụ abcdefg: a -> ab -> abc -> abcd -> bcde -> cdef -> defg
  if (textEffect == 1) 
  {
    unsigned long now = millis();

    if (now - effectTime >= TYPE_DELAY) {
      effectTime = now;

      if (typeIndex < len) {
        typeIndex++;
      } else 
      {
        delay(800);

        currentLoop++;

        if (currentLoop < numLoops) {
          typeIndex = 0;
        } else {
          currentLoop = 0;
          currentState = STOPPED;
          lmd.clear();
          lmd.display();
          return;
        }
      }
    }

    lmd.clear();

    int maxChars = LEDMATRIX_WIDTH / 8; // 32 / 8 = 4 ký tự
    int startIndex = 0;

    if (typeIndex > maxChars) {
      startIndex = typeIndex - maxChars;
    }

    int displayLen = typeIndex - startIndex;

    char temp[75];

    for (int i = 0; i < displayLen; i++) {
      temp[i] = theText[startIndex + i];
    }

    temp[displayLen] = '\0';

    if (showText && displayLen > 0) {
      drawString(temp, strlen(temp), 0, 0);
    }

    lmd.display();
    return;
  }
}

void handleRequest(String req) {
  if (req.indexOf('?') <= 0) return;

  String params = req.substring(req.indexOf('?') + 1);

  String newText = getParam(params, "text");
  if (newText.length() > 0) {
    newText = urlDecode(newText);
    safeCopyText(newText);

    x = LEDMATRIX_WIDTH;
    currentLoop = 0;
    displayOn = true;
    currentState = RUNNING;
    lmd.clear();
  }

  String speedStr = getParam(params, "speed");
  if (speedStr.length() > 0) {
    animationSpeed = speedStr.toInt();
    if (animationSpeed < 10) animationSpeed = 10;
    if (animationSpeed > 500) animationSpeed = 500;
  }

  String brightnessStr = getParam(params, "brightness");
  if (brightnessStr.length() > 0) {
    brightness = brightnessStr.toInt();
    if (brightness < 0) brightness = 0;
    if (brightness > 15) brightness = 15;
    lmd.setIntensity(brightness);
  }

  String loopsStr = getParam(params, "loops");
  if (loopsStr.length() > 0) {
    numLoops = loopsStr.toInt();
    if (numLoops < 1) numLoops = 1;
    currentLoop = 0;
  }

  String blinkStr = getParam(params, "blink");
  enableBlink = blinkStr == "1";

  String stopStr = getParam(params, "stop");
  if (stopStr == "1") 
  {
    currentState = STOPPED;
    displayOn = false;
    lmd.clear();
    lmd.display();
  } else {
    displayOn = true;
    currentState = RUNNING;
  }
// Thêm xử lý effect
  String effectStr = getParam(params, "effect");
  if (effectStr.length() > 0) {
   textEffect = effectStr.toInt();

   if (textEffect < 0) textEffect = 0;
   if (textEffect > 1) textEffect = 1;

   x = LEDMATRIX_WIDTH;
  typeIndex = 0;
  effectTime = millis();
  currentLoop = 0;
}
}

void sendWebPage(WiFiClient client) {
  String s = "HTTP/1.1 200 OK\r\nContent-Type: text/html\r\n\r\n";
  s += "<!DOCTYPE html><html><head>";
  s += "<meta name='viewport' content='width=device-width, initial-scale=1'>";
  s += "<title>LED Matrix Control</title>";
  s += "</head><body>";
  s += "<h1>LED Matrix Control</h1>";
  s += "<form action='/'>";
  s += "Text: <input type='text' name='text' value='" + String(text) + "'><br><br>";
  s += "Speed: <input type='number' name='speed' value='" + String(animationSpeed) + "'><br><br>";
  s += "Brightness: <input type='number' name='brightness' value='" + String(brightness) + "' min='0' max='15'><br><br>";
  s += "Loops: <input type='number' name='loops' value='" + String(numLoops) + "' min='1'><br><br>";

  s += "Blink: <input type='checkbox' name='blink' value='1' ";
  if (enableBlink) s += "checked";
  s += "><br><br>";

  s += "Stop: <input type='checkbox' name='stop' value='1'><br><br>";
  s += "<input type='submit' value='Update'>";
  s += "</form>";
  s += "</body></html>";

  client.print(s);
}

// ================= SETUP =================
void setup() {
  Serial.begin(115200);

  lmd.setEnabled(true);
  lmd.setIntensity(brightness);

  safeCopyText("Connecting");

  WiFi.begin(ssid, password);

  while (WiFi.status() != WL_CONNECTED) {
    displayText(text);
    delay(ANIM_DELAY);
  }

  server.begin();

  ip = WiFi.localIP();
  Serial.println(ip);

  String ipStr = String(ip[0]) + "." + String(ip[1]) + "." + String(ip[2]) + "." + String(ip[3]);
  safeCopyText(ipStr);

  x = LEDMATRIX_WIDTH;
  currentState = RUNNING;
  displayOn = true;
  currentLoop = 0;
  myTime = millis();
}

// ================= LOOP =================
void loop() {
  if (enableBlink) {
    if (millis() - lastBlinkTime > BLINK_INTERVAL) {
      showText = !showText;
      lastBlinkTime = millis();
    }
  } else {
    showText = true;
  }

  if (displayOn && currentState == RUNNING) {
    displayText(text);
  } else {
    lmd.clear();
    lmd.display();
  }

  WiFiClient client = server.available();
  if (!client) return;

  while (client.connected() && !client.available()) {
    if (displayOn && currentState == RUNNING) {
      displayText(text);
    }
    delay(1);
  }

  String req = client.readStringUntil('\r');
  client.flush();

  Serial.println(req);

  handleRequest(req);
  sendWebPage(client);

  delay(1);
  client.stop();
}